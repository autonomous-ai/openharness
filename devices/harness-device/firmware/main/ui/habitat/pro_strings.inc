// Built-in Pro interface copy. Format arguments match in both languages.
{"%.32s / answer %d of %d", "%.32s / trả lời %d / %d"},
{"%d - %d of %d", "%d - %d / %d"},
{"%d line%s from %s", "%d dòng%s từ %s"},
{"%d line%s selected", "Đã chọn %d dòng%s"},
{"%d of %d", "%d / %d"},
{"%d of %d matches", "Kết quả %d / %d"},
{"%d of %d workspaces", "Không gian %d / %d"},
{"%s / %d of %d", "%s / %d / %d"},
{"%s for %s", "%s cho %s"},
{"%u of %u", "%u / %u"},
{"16 kHz mono / saved IMA ADPCM / soft gain 4x", "16 kHz mono / IMA ADPCM / khuếch đại 4x"},
{"A fifteen minute nap", "Nghỉ trong mười lăm phút"},
{"A gentle response to disappointment.", "Phản hồi nhẹ nhàng khi thất vọng."},
{"A little company", "Một người bạn"},
{"A little update.", "Đang cập nhật."},
{"A new thought", "Một ý tưởng mới"},
{"A nonverbal reaction tag before spoken words.", "Tiếng cười trước khi nói."},
{"A place for your next idea.", "Nơi dành cho ý tưởng mới."},
{"A question for you", "Câu hỏi dành cho bạn"},
{"A quick note", "Thông tin"},
{"A quiet moment.", "Một chút yên tĩnh."},
{"A result is ready", "Đã có kết quả"},
{"Add to your message", "Thêm vào tin nhắn"},
{"All caught up.", "Đã xem hết."},
{"Already answered elsewhere.", "Đã trả lời ở nơi khác."},
{"An answer was already sent. Check the terminal.", "Đã gửi câu trả lời. Hãy kiểm tra trên máy tính."},
{"Angry at the glitch", "Bực vì sự cố"},
{"Answer", "Trả lời"},
{"Answer %d of %d", "Trả lời %d / %d"},
{"App pane", "Khung ứng dụng"},
{"Appearance changed; saving failed.", "Đã đổi diện mạo nhưng chưa lưu được."},
{"Applies to menus and your next recording.", "Áp dụng cho giao diện và lần ghi âm tiếp theo."},
{"At ease", "Thư thái"},
{"Audio tag: [%s]", "Sắc thái: [%s]"},
{"Back", "Quay lại"},
{"Back to playback", "Về trình phát"},
{"Back to your message", "Về tin nhắn"},
{"Baseline for the voice, model and tuning comparisons.", "Mẫu để so sánh giọng, mô hình và thông số."},
{"Bright and warm", "Tươi sáng, ấm áp"},
{"Brightness", "Độ sáng"},
{"Brightness / %d%%", "Độ sáng / %d%%"},
{"By line", "Theo dòng"},
{"Cable busy. Try again.", "Kết nối bận. Hãy thử lại."},
{"Cannot show that answer. Say it again or use the terminal.", "Không hiển thị được. Hãy nói lại hoặc dùng máy tính."},
{"Carried text", "Văn bản mang theo"},
{"Carry review is unavailable. Your text was not sent.", "Không thể xem lại đoạn mang theo. Văn bản chưa được gửi."},
{"Carry text", "Mang theo"},
{"Change your workspace", "Đổi không gian làm việc"},
{"Character changed; saving failed.", "Đã đổi nhân vật nhưng chưa lưu được."},
{"Characters", "Nhân vật"},
{"Check delivery", "Kiểm tra gửi"},
{"Check in Harness", "Kiểm tra trong Harness"},
{"Check the desktop for delivery.", "Kiểm tra việc gửi trên máy tính."},
{"Choices", "Lựa chọn"},
{"Choose", "Chọn"},
{"Choose a pane", "Chọn tác nhân"},
{"Choose a passage to talk about or carry", "Chọn đoạn để thảo luận hoặc mang theo"},
{"Choose a tab", "Chọn không gian"},
{"Choose a tab to get started.", "Chọn không gian để bắt đầu."},
{"Choose an answer", "Chọn câu trả lời"},
{"Choose any", "Chọn nhiều"},
{"Choose one", "Chọn một"},
{"Choose sources in Harness.", "Chọn nguồn trong Harness."},
{"Choose the pane and instruction again.", "Chọn lại khung và chỉ dẫn."},
{"Choose who to talk to", "Chọn người trò chuyện"},
{"Choose your company", "Chọn bạn đồng hành"},
{"Choose your display and voice language.", "Chọn ngôn ngữ hiển thị và giọng nói."},
{"Choosing...", "Đang chọn..."},
{"Close", "Đóng"},
{"Close removes this copy.", "Đóng sẽ xóa bản sao này."},
{"Closer adherence to the reference voice.", "Bám sát giọng mẫu hơn."},
{"Companion", "Bạn đồng hành"},
{"Companion / gestures", "Bạn đồng hành / cử chỉ"},
{"Confirming your answer...", "Đang xác nhận câu trả lời..."},
{"Connect to Harness", "Kết nối với Harness"},
{"Connect to your computer", "Kết nối với máy tính"},
{"Connection ended. Check the desktop before starting again.", "Kết nối đã ngắt. Kiểm tra máy tính trước khi bắt đầu lại."},
{"Controls", "Cài đặt"},
{"Could not confirm sending. Check the terminal.", "Chưa xác nhận gửi. Kiểm tra trên máy tính."},
{"Could not confirm. Check the terminal.", "Chưa xác nhận được. Hãy kiểm tra trên máy tính."},
{"Could not load the question.", "Không tải được câu hỏi."},
{"Could not load. Open the alert again.", "Không tải được. Hãy mở lại thông báo."},
{"Could not open", "Không mở được"},
{"Could not refresh the tab. Try again.", "Chưa làm mới được. Hãy thử lại."},
{"Could not save. Tap a language to retry.", "Chưa lưu được. Chạm để thử lại."},
{"Create one in the desktop app.", "Tạo trong ứng dụng trên máy tính."},
{"Create through the desktop's form", "Tạo từ biểu mẫu trên máy tính"},
{"Curious", "Tò mò"},
{"Daemon", "Bạn đồng hành"},
{"Delivery not confirmed. Check the desktop.", "Chưa xác nhận gửi. Hãy kiểm tra máy tính."},
{"Delivery unconfirmed", "Chưa xác nhận gửi"},
{"Device busy", "Thiết bị đang bận"},
{"Device busy. Choose the tab again.", "Thiết bị bận. Hãy chọn lại không gian."},
{"Discard", "Bỏ"},
{"Draft", "Bản nháp"},
{"Draft unavailable. Check the terminal.", "Không có bản nháp. Kiểm tra máy tính."},
{"Draw your pattern to return.", "Vẽ hình mở khóa để trở lại."},
{"Drop", "Bỏ"},
{"Dusk", "Hoàng hôn"},
{"Earlier", "Trước"},
{"Excited", "Hào hứng"},
{"Find", "Tìm"},
{"Find %.48s", "Tìm %.48s"},
{"Find Harness", "Tìm Harness"},
{"Find an existing Harness by voice", "Tìm Harness bằng giọng nói"},
{"Find in output", "Tìm trong kết quả"},
{"Finding available models...", "Đang tìm mô hình..."},
{"Finding its home...", "Đang tìm nơi phù hợp..."},
{"Finding the text...", "Đang tìm văn bản..."},
{"Finding your panes...", "Đang tìm tác nhân..."},
{"Finding your workspace...", "Đang tìm không gian..."},
{"Finding...", "Đang tìm..."},
{"Finished. Tap Play to hear it again.", "Đã phát xong. Chạm Phát để nghe lại."},
{"Frustration aimed at a problem, never at you.", "Bực bội với sự cố, không phải với bạn."},
{"Full passage stays attached.", "Toàn bộ đoạn vẫn được đính kèm."},
{"Getting ready...", "Đang chuẩn bị..."},
{"Goal", "Mục tiêu"},
{"Happy", "Vui vẻ"},
{"Higher stability: a more consistent performance.", "Độ ổn định cao: giọng nói nhất quán hơn."},
{"Home", "Trang chủ"},
{"Husky trickster", "Tinh nghịch, trầm khàn"},
{"I'll let you know when something arrives.", "Tôi sẽ báo khi có tin mới."},
{"Inbox", "Hộp thư"},
{"Included", "Đã tính"},
{"Instruct", "Chỉ dẫn"},
{"Instruction unavailable", "Chỉ dẫn không khả dụng"},
{"Just watch", "Ngắm thôi"},
{"Keep the face still when you need focus", "Giữ yên khi bạn cần tập trung"},
{"Keep working", "Tiếp tục"},
{"Keep your companion connected.", "Giữ kết nối với bạn đồng hành."},
{"Keep your place while visiting new output", "Giữ vị trí khi xem kết quả mới"},
{"Keeping your reading place...", "Đang giữ vị trí đọc..."},
{"Language", "Ngôn ngữ"},
{"Later", "Để sau"},
{"Latest output", "Kết quả mới nhất"},
{"Latest result", "Kết quả mới nhất"},
{"Laugh", "Cười"},
{"Less strict adherence to the reference voice.", "Ít bám sát giọng mẫu hơn."},
{"List", "Danh sách"},
{"List +%d", "DS +%d"},
{"Listen for an inquisitive rise and playful pacing.", "Nghe cách lên giọng tò mò và nhịp vui tươi."},
{"Listen for energy, pitch movement and emphasis.", "Nghe năng lượng, cao độ và cách nhấn giọng."},
{"Listen for warmth and a smile in the delivery.", "Nghe sự ấm áp và nụ cười trong giọng nói."},
{"Listening...", "Đang nghe..."},
{"Look at your desktop. Drag here to choose a line.", "Xem máy tính. Kéo ở đây để chọn dòng."},
{"Loop", "Lặp lại"},
{"Lower stability: more varied, expressive performance.", "Độ ổn định thấp: đa dạng và biểu cảm hơn."},
{"Machines", "Máy tính"},
{"Make it yours", "Tùy chỉnh thiết bị"},
{"Map", "Sơ đồ"},
{"Match daemon", "Theo bạn đồng hành"},
{"Meadow", "Đồng cỏ"},
{"Meet the living ones", "Gặp những người bạn"},
{"Menu", "Menu"},
{"Message options", "Tùy chọn tin nhắn"},
{"Model", "Mô hình"},
{"More", "Thêm"},
{"Motion, rest and brightness", "Chuyển động, nghỉ và độ sáng"},
{"Needs attention", "Cần chú ý"},
{"Needs your answer", "Cần bạn trả lời"},
{"New Harness", "Harness mới"},
{"New instruction", "Chỉ dẫn mới"},
{"Next", "Tiếp"},
{"Next answer", "Câu tiếp"},
{"No answer receipt. Check the terminal before trying again.", "Chưa xác nhận trả lời. Kiểm tra máy tính trước khi thử lại."},
{"No computers available yet.", "Chưa có máy tính khả dụng."},
{"No matches. Try another phrase.", "Không tìm thấy. Thử cụm từ khác."},
{"No models available.", "Chưa có mô hình."},
{"No pane selected", "Chưa chọn tác nhân"},
{"No preview available.", "Chưa có nội dung xem trước."},
{"No reply. Check Harness on desktop.", "Chưa phản hồi. Kiểm tra Harness trên máy tính."},
{"No reply. Check the draft status.", "Chưa phản hồi. Kiểm tra bản nháp."},
{"No response", "Chưa có phản hồi"},
{"No response yet. Check Harness on your computer.", "Chưa có phản hồi. Kiểm tra Harness trên máy tính."},
{"No result to read yet. I'll bring it here when it's ready.", "Chưa có kết quả. Tôi sẽ đưa đến đây khi có."},
{"No saved answer.", "Không có bản trả lời đã lưu."},
{"No tabs yet.", "Chưa có không gian."},
{"Nothing is sent until you choose Send.", "Chỉ gửi khi bạn chọn Gửi."},
{"Notification sounds", "Âm thanh thông báo"},
{"Off", "Tắt"},
{"Older scan: about %u min ago", "Dữ liệu cũ: khoảng %u phút trước"},
{"On your desktop", "Trên máy tính"},
{"One line", "Một dòng"},
{"One moment", "Vui lòng đợi"},
{"One moment...", "Vui lòng đợi..."},
{"One request", "Một yêu cầu"},
{"Open New Harness on your computer.", "Mở Harness mới trên máy tính."},
{"Open on desktop", "Mở trên máy tính"},
{"Open the alert again.", "Hãy mở lại thông báo."},
{"Open the update again.", "Hãy mở lại thông báo."},
{"Opening your workspace...", "Đang mở không gian..."},
{"Opening...", "Đang mở..."},
{"Opted-in sources", "Nguồn đã cho phép"},
{"Opted-in sources only.", "Chỉ nguồn đã cho phép."},
{"Original excited", "Hào hứng ban đầu"},
{"Panes", "Tác nhân"},
{"Paper", "Giấy"},
{"Params", "Thông số"},
{"Part %d of %d / %s", "Phần %d / %d / %s"},
{"Partial", "Một phần"},
{"Partial coverage", "Dữ liệu chưa đầy đủ"},
{"Passage preview", "Xem trước đoạn"},
{"Pattern editing is available in the standard firmware.", "Đổi hình mở khóa trong firmware tiêu chuẩn."},
{"Pattern setup", "Cài đặt hình mở khóa"},
{"Picking up your text...", "Đang lấy văn bản..."},
{"Play", "Phát"},
{"Playful baseline", "Mẫu vui tươi"},
{"Playing", "Đang phát"},
{"Please wait", "Vui lòng đợi"},
{"Preference changed; saving failed.", "Đã đổi cài đặt nhưng chưa lưu được."},
{"Preparing your words...", "Đang xử lý lời nói..."},
{"Preview kept here.", "Bản xem trước còn ở đây."},
{"Previous", "Trước"},
{"Question", "Câu hỏi"},
{"Question %d of %d", "Câu hỏi %d / %d"},
{"Question changed", "Câu hỏi đã thay đổi"},
{"Question did not arrive. Open the alert again.", "Chưa nhận được câu hỏi. Hãy mở lại thông báo."},
{"Quiet delivery; use volume to compare speaker detail.", "Nói nhỏ; đổi âm lượng để nghe rõ chi tiết."},
{"Quiet motion / off", "Chuyển động nhẹ / tắt"},
{"Quiet motion / on", "Chuyển động nhẹ / bật"},
{"Range", "Một đoạn"},
{"Reach another computer", "Kết nối máy khác"},
{"Read", "Đọc"},
{"Read what came back", "Xem kết quả mới"},
{"Reading local usage...", "Đang đọc mức dùng cục bộ..."},
{"Reading the question...", "Đang tải câu hỏi..."},
{"Reading...", "Đang đọc..."},
{"Ready", "Sẵn sàng"},
{"Ready for you", "Đã sẵn sàng"},
{"Ready when you are", "Sẵn sàng cùng bạn"},
{"Recipient unavailable. Your message is still here.", "Không tìm thấy người nhận. Tin nhắn vẫn ở đây."},
{"Recording stopped. Please try again.", "Đã ngừng ghi âm. Hãy thử lại."},
{"Refresh", "Làm mới"},
{"Refresh for the new day.", "Làm mới để xem ngày mới."},
{"Release to review.", "Thả để xem lại."},
{"Rest", "Nghỉ ngơi"},
{"Restore the previous wording", "Khôi phục nội dung trước"},
{"Result", "Kết quả"},
{"Retry", "Thử lại"},
{"Return", "Trở lại"},
{"Return to your companion", "Đánh thức bạn đồng hành"},
{"Returned", "Đã trở lại"},
{"Returning", "Đang trở lại"},
{"Review", "Xem lại"},
{"Review answer", "Xem câu trả lời"},
{"Review before sending.", "Xem lại trước khi gửi."},
{"Review before you send", "Xem lại trước khi gửi"},
{"Review first", "Xem trước"},
{"Review your answer", "Xem lại câu trả lời"},
{"Sad", "Buồn"},
{"Same words and settings; a different voice.", "Cùng lời nói và cài đặt; giọng khác."},
{"Same words, voice and settings as the v4 baseline.", "Cùng lời, giọng và thông số với mẫu v4."},
{"Saved on this device.", "Đã lưu trên thiết bị."},
{"Saved on this device. Tap Play.", "Đã lưu trên thiết bị. Chạm Phát."},
{"Saving...", "Đang lưu..."},
{"Say a name", "Nói tên"},
{"Say a task and an interval", "Nói tác vụ và khoảng lặp lại"},
{"Say an answer", "Nói câu trả lời"},
{"Say it again", "Nói lại"},
{"Scan: about %u min ago", "Đọc: khoảng %u phút trước"},
{"Scan: less than 1 min ago", "Đọc: chưa đầy 1 phút trước"},
{"Scene", "Khung cảnh"},
{"Seed: %ld (best effort)", "Seed: %ld (không bảo đảm)"},
{"Seed: provider default", "Seed: mặc định"},
{"Select text", "Chọn văn bản"},
{"Select the text again, or drop it to start fresh.", "Chọn lại văn bản hoặc bỏ để bắt đầu mới."},
{"Select this answer", "Chọn câu trả lời này"},
{"Selected", "Đã chọn"},
{"Selected / tap to remove", "Đã chọn / chạm để bỏ"},
{"Selected text expired", "Văn bản đã hết hạn"},
{"Send answer", "Gửi trả lời"},
{"Send message", "Gửi tin nhắn"},
{"Sending...", "Đang gửi..."},
{"Set the backdrop", "Chọn phông nền"},
{"Shore", "Bờ biển"},
{"Similarity: 0.25", "Tương đồng: 0.25"},
{"Similarity: 1", "Tương đồng: 1"},
{"Sleepy", "Buồn ngủ"},
{"Some characters can't be shown. Say this part again.", "Có ký tự không hiển thị được. Hãy nói lại."},
{"Sound", "Âm thanh"},
{"Sound / muted", "Âm thanh / tắt"},
{"Sound / on", "Âm thanh / bật"},
{"Sound changed; saving failed.", "Đã đổi âm thanh nhưng chưa lưu được."},
{"Speak", "Nói"},
{"Speak another part", "Nói thêm một phần"},
{"Speak to this pane.", "Nói với khung này."},
{"Speaking. Touch to interrupt.", "Đang nói. Chạm để ngắt."},
{"Stability %u.%02u    Similarity %u.%02u", "Ổn định %u.%02u    Tương đồng %u.%02u"},
{"Stability: 0", "Ổn định: 0"},
{"Stability: 1", "Ổn định: 1"},
{"Starting...", "Đang bắt đầu..."},
{"Stop", "Dừng"},
{"Stop current turn", "Dừng lượt hiện tại"},
{"Stop sending", "Dừng gửi"},
{"Stop this turn", "Dừng lượt này"},
{"Stop this turn?", "Dừng lượt này?"},
{"Surprised", "Ngạc nhiên"},
{"Swipe for choices. Tap to confirm one.", "Vuốt xem lựa chọn. Chạm để xác nhận."},
{"Swipe for other updates. Opening changes your pane.", "Vuốt xem tin khác. Mở để chuyển tác nhân."},
{"Swipe to browse controls.", "Vuốt để xem cài đặt."},
{"Swipe to browse. Tap a pane to focus it.", "Vuốt để xem. Chạm để chọn tác nhân."},
{"Swipe to browse. Tap to choose.", "Vuốt để xem. Chạm để chọn."},
{"Swipe to read and move through choices.", "Vuốt để đọc và xem lựa chọn khác."},
{"Swipe to read this result.", "Vuốt để đọc kết quả."},
{"Swipe to read.", "Vuốt để đọc."},
{"Swipe to read. Hold the text for more options.", "Vuốt để đọc. Giữ văn bản để xem tùy chọn."},
{"Swipe to read. Nothing is sent until you confirm.", "Vuốt để đọc. Xác nhận rồi mới gửi."},
{"Switching tab", "Đang đổi không gian"},
{"Tabs", "Không gian"},
{"Tags guide delivery; results can vary.", "Sắc thái chỉ dẫn cách nói; kết quả có thể khác."},
{"Taking a little rest", "Đang nghỉ một chút"},
{"Tap the creature to finish", "Chạm để kết thúc"},
{"Tap the passage to talk about it.", "Chạm vào đoạn để nói về nội dung."},
{"Tap the text to say this part again.", "Chạm vào văn bản để nói lại phần này."},
{"Tap to change the backlight", "Chạm để đổi độ sáng"},
{"Tap to cycle the backlight", "Chạm để đổi độ sáng"},
{"Tap to finish speaking.", "Chạm để kết thúc nói."},
{"Tap to review.", "Chạm để xem lại."},
{"Tap to send. Hold to review first.", "Chạm để gửi. Giữ để xem lại."},
{"Tap to switch here", "Chạm để chuyển đến đây"},
{"Task", "Tác vụ"},
{"That pattern didn't match. Try again.", "Hình chưa đúng. Hãy thử lại."},
{"That workspace is gone. Choose another.", "Không gian không còn. Hãy chọn nơi khác."},
{"The app did not answer. Try the alert again.", "Ứng dụng chưa phản hồi. Thử mở lại thông báo."},
{"The cable is busy. Try again.", "Kết nối đang bận. Hãy thử lại."},
{"The layout is updating.", "Đang cập nhật bố cục."},
{"The machine did not answer. Please try again.", "Máy tính chưa phản hồi. Hãy thử lại."},
{"The question changed. Open the alert again.", "Câu hỏi đã thay đổi. Hãy mở lại thông báo."},
{"The same original clip used in our speaker test.", "Bản thu gốc dùng để thử loa."},
{"The tab did not open. Choose it again.", "Chưa mở được không gian. Hãy chọn lại."},
{"Then choose who gets it.", "Sau đó chọn người nhận."},
{"This Harness", "Harness này"},
{"This computer", "Máy tính này"},
{"This computer / ", "Máy này / "},
{"This computer only.", "Chỉ máy tính này."},
{"This question needs the desktop.", "Hãy trả lời trên máy tính."},
{"Today", "Hôm nay"},
{"Try again", "Thử lại"},
{"Try again in Harness.", "Thử lại trong Harness."},
{"Turbo comparison", "So sánh Turbo"},
{"USD estimate", "Ước tính bằng USD"},
{"Unavailable", "Không có dữ liệu"},
{"Undo your last edit", "Hoàn tác chỉnh sửa"},
{"Unpriced", "Chưa có giá"},
{"Untitled", "Chưa đặt tên"},
{"Update Harness to read usage.", "Cập nhật Harness để đọc mức dùng."},
{"Updates", "Thông báo"},
{"Use", "Dùng"},
{"Visit", "Xem"},
{"Visit ended", "Đã kết thúc xem"},
{"Voice", "Giọng nói"},
{"Voice ID: %s", "Mã giọng: %s"},
{"Voice allowance reached.", "Đã hết hạn mức giọng nói."},
{"Voice parameters", "Thông số giọng nói"},
{"Voice unavailable. Text is still here.", "Chưa phát được. Vẫn có văn bản."},
{"Voice was not sent. Try again.", "Chưa gửi được. Hãy thử lại."},
{"Volume %u%%", "Âm lượng %u%%"},
{"Waiting for that pane...", "Đang đợi tác nhân..."},
{"Wake", "Thức dậy"},
{"Whisper", "Thì thầm"},
{"With text from %s", "Kèm văn bản từ %s"},
{"Work toward an objective", "Làm việc hướng tới mục tiêu"},
{"Working", "Đang làm việc"},
{"Working...", "Đang xử lý..."},
{"Workspace", "Không gian làm việc"},
{"Workspaces", "Không gian làm việc"},
{"You'll review before stopping", "Xác nhận trước khi dừng"},
{"Your answer goes only to this question.", "Chỉ gửi câu trả lời cho câu hỏi này."},
{"Your companion is locked.", "Bạn đồng hành đã khóa."},
{"Your current workspace", "Không gian hiện tại"},
{"Your latest result", "Kết quả mới nhất"},
{"Your message", "Tin nhắn của bạn"},
{"Your words stay with the selected pane.", "Lời nói được gửi đến tác nhân đã chọn."},
{"Your work stays. Only the current turn will stop.", "Công việc vẫn được giữ. Chỉ dừng lượt hiện tại."},
{"check delivery", "kiểm tra gửi"},
{"connecting", "đang kết nối"},
{"not sent yet", "chưa gửi"},
{"offline", "ngoại tuyến"},
{"ready", "sẵn sàng"},
{"s", ""},
{"sending", "đang gửi"},
{"stability: %u.%02u   similarity: %u.%02u", "ổn định: %u.%02u   tương đồng: %u.%02u"},
{"starting", "đang khởi động"},
{"stopped", "đã dừng"},
{"v4: no speed, style, speaker boost or SSML.", "v4: không có tốc độ, phong cách hay SSML."},
